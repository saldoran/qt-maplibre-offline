## yocto/meta-poc-map/conf/layer.conf
```bitbake
BBPATH .= ":${LAYERDIR}"

BBFILES += "${LAYERDIR}/recipes-*/*/*.bb \
            ${LAYERDIR}/recipes-*/*/*.bbappend"

BBFILE_COLLECTIONS += "poc-map"
BBFILE_PATTERN_poc-map = "^${LAYERDIR}/"
BBFILE_PRIORITY_poc-map = "10"

LAYERDEPENDS_poc-map = "core qt6-layer"
LAYERSERIES_COMPAT_poc-map = "scarthgap"
```
